## configs/generic-x86_defconfig
```kconfig
BR2_x86_generic=y
BR2_TOOLCHAIN_EXTERNAL=y
BR2_ENABLE_LOCALE_PURGE=y
BR2_ENABLE_LOCALE_WHITELIST="C"
BR2_TARGET_GENERIC_HOSTNAME="nerves"
BR2_TARGET_GENERIC_ISSUE=""
BR2_ROOTFS_DEVICE_CREATION_DYNAMIC_EUDEV=y
BR2_TARGET_GENERIC_GETTY_PORT="tty1"
BR2_TARGET_GENERIC_GETTY_BAUDRATE_KEEP=y
# BR2_TARGET_GENERIC_REMOUNT_ROOTFS_RW is not set
BR2_ROOTFS_OVERLAY="../board/nerves-common/rootfs-additions"
BR2_ROOTFS_POST_IMAGE_SCRIPT="../board/generic-x86/post-createfs.sh"
BR2_LINUX_KERNEL=y
BR2_LINUX_KERNEL_CUSTOM_VERSION=y
BR2_LINUX_KERNEL_CUSTOM_VERSION_VALUE="3.13.5"
BR2_LINUX_KERNEL_USE_CUSTOM_CONFIG=y
BR2_LINUX_KERNEL_CUSTOM_CONFIG_FILE="../board/generic-x86/linux-3.13.config"
BR2_LINUX_KERNEL_EXT_UNIONFS=y
BR2_LINUX_KERNEL_EXT_UNIONFS_CUSTOM_VERSION=y
BR2_LINUX_KERNEL_EXT_UNIONFS_CUSTOM_VERSION_VALUE="3.13.0-rc2"
BR2_PACKAGE_MTOOLS=y
BR2_PACKAGE_XORG7=y
BR2_PACKAGE_XSERVER_XORG_SERVER=y
BR2_PACKAGE_XSERVER_XORG_SERVER_MODULAR=y
BR2_PACKAGE_XAPP_TWM=y
BR2_PACKAGE_XAPP_XCLOCK=y
BR2_PACKAGE_XAPP_XINIT=y
BR2_PACKAGE_XAPP_XINPUT=y
BR2_PACKAGE_XDRIVER_XF86_INPUT_KEYBOARD=y
BR2_PACKAGE_XDRIVER_XF86_INPUT_MOUSE=y
BR2_PACKAGE_XDRIVER_XF86_VIDEO_FBDEV=y
BR2_PACKAGE_XDRIVER_XF86_VIDEO_INTEL=y
BR2_PACKAGE_XDRIVER_XF86_VIDEO_VESA=y
BR2_PACKAGE_MCOOKIE=y
BR2_PACKAGE_XTERM=y
BR2_PACKAGE_LIBERATION=y
BR2_PACKAGE_OPENSSL=y
BR2_TARGET_ROOTFS_EXT2=y
BR2_TARGET_ROOTFS_EXT2_4=y
BR2_TARGET_ROOTFS_TAR_GZIP=y
BR2_TARGET_SYSLINUX=y
# BR2_TARGET_SYSLINUX_ISOLINUX is not set
# BR2_TARGET_SYSLINUX_PXELINUX is not set
BR2_PACKAGE_HOST_DOSFSTOOLS=y
BR2_PACKAGE_HOST_MTOOLS=y
BR2_PACKAGE_MMCCOPY=y
BR2_PACKAGE_NERVES_MINIMAL=y
BR2_PACKAGE_HOST_ELIXIR=y
BR2_PACKAGE_HOST_MMCCOPY=y
BR2_PACKAGE_HOST_ERLANG_RELSYNC=y
BR2_PACKAGE_HOST_ERLANG_FWTOOL=y
```
